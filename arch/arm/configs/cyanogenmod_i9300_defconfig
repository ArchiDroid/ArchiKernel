## drivers/development_tool/Kconfig
```kconfig
#
# Vibrator device configuration
#

menu "FIH development tool"

config FIH_DEVELOPMENT_TOOL
	bool "use FIH development tool"
	help
	  FIH development tool.

endmenu
```

## drivers/input/sensor/Kconfig
```kconfig
#
# Sensor driver configuration
#
menuconfig INPUT_SENSOR
	bool "Sensors"
	help
	  Say Y here, and a list of supported touchscreens will be displayed.
	  This option doesn't affect the kernel.

	  If unsure, say Y.

if INPUT_SENSOR

config SENSOR_GP2AP
	tristate "GP2AP based proximity sensor"
	help
	  Say Y here if you have a sensor interface using the
	  GP2AP controller, and your board-specific
	  setup code includes i2c devices.

	  If unsure, say N (but it's safe to say "Y").

	  To compile this driver as a module, choose M here: the
	  module will be called ads7846.

config SENSORS_BMA250
	tristate "BMA250 Acceleration Sensor Driver"
	depends on I2C
	help
	 BMA250 Acceleration Sensor Driver implemented by Bosch-Sensortec.

#LGE_CHANGE : 2012-10-24 Sanghun,Lee(eee3114.@lge.com) sensor change from bmc150 to bmc050
config SENSORS_BMA2X2
	tristate "BMA255/BMA250E/BMA222E/BMA280 acceleration sensor support"
	depends on I2C=y
	help
	  If you say yes here you get support for Bosch Sensortec's 
	  acceleration sensors BMA255/BMA250E/BMA222E/BMA280.
#LGE_CHANGE : 2012-10-24 Sanghun,Lee(eee3114.@lge.com) sensor change from bmc150 to bmc050

config SENSORS_BMM050
	tristate "BMM050 Magnetic Sensor Driver"
	depends on I2C
	help
	 BMM050 Magnetic Sensor Driver implemented by Bosch-Sensortec.	  

config SENSOR_APDS9190
	tristate "APDS based proximity sensor"
	help
	  Say Y here if you have a sensor interface using the
	  APDS controller, and your board-specific
	  setup code includes i2c devices.

	  If unsure, say N (but it's safe to say "Y").

	  To compile this driver as a module, choose M here: the
	  module will be called apds9190.

#LGE_CHANGE : 2013-02-04 jinseok.choi@lge.com V1 uses Rohm RPR0400 for Proximity Sensor
config SENSOR_RPR0400
	tristate "RPR0400 based proximity sensor"
	help
	  Say Y here if you have a sensor interface using the
	  RPR0400 controller, and your board-specific
	  setup code includes i2c devices.

	  If unsure, say N (but it's safe to say "Y").

	  To compile this driver as a module, choose M here: the
	  module will be called rpr0400.

#[LGSI_SP4_BSP_BEGIN][kirankumar.vm@lge.com] Avago Proximity Changes
config SENSOR_APDS9130
       tristate "APDS9130 Proximity Sensor Driver"
       depends on I2C
       help
        APDS9130 Proximity Sensor Driver implemented by Avago Tech.
#[LGSI_SP4_BSP_END][kirankumar.vm@lge.com] Avago Proximity Changes

endif
```

## drivers/input/sensor/alps_IF_Driver/Kconfig
```kconfig
config SENSOR_HSCDTD004A
	tristate "HSCDTD004A compass sensor support"
	depends on I2C && INPUT_POLLDEV
	help
	  If you say yes here you get support for ALPS's 
	  acceleration sensors HSCDTD004A.
```

## drivers/input/touchscreen/synaptics-rmi/Kconfig
```kconfig
#
# Touchscreen driver configuration
#
config TOUCHSCREEN_SYNAPTICS_DSX_RMI4_I2C
	tristate "Synaptics DSX I2C touchscreen"
	depends on I2C
	help
	  Say Y here if you have a Synaptics DSX I2C touchscreen
	  connected to your system.

	  If unsure, say N.

	  To compile this driver as a module, choose M here: the
	  module will be called synaptics_dsx_rmi4_i2c.

config TOUCHSCREEN_SYNAPTICS_DSX_RMI4_DEV
	tristate "Synaptics I2C touchscreen char device"
	depends on TOUCHSCREEN_SYNAPTICS_DSX_RMI4_I2C
	help
	  This enables support for character device channel for Synaptics RMI
	  touchscreens.

config TOUCHSCREEN_SYNAPTICS_DSX_RMI4_FW_UPDATE
	tristate "Synaptics I2C touchscreen firmware update"
	depends on TOUCHSCREEN_SYNAPTICS_DSX_RMI4_I2C
	help
	  This enables support for firmware update for Synaptics RMI
	  touchscreens.

config FIH_TOUCH_TOOLS
        tristate "FIH touch tools"
        default n
        depends on TOUCHSCREEN_SYNAPTICS_DSX_RMI4_I2C
        select FIH_DEVELOPMENT_TOOL
        help
          This is touch tool.
```

## drivers/media/video/msm/Kconfig
```kconfig
config MSM_CAMERA_V4L2
        bool "MSM Camera V4L2 Interface"
        depends on MSM_CAMERA
        default n
        ---help---
          This flag enables V4L2 interface of MSM
          camera driver. If enabled, application interacts
          with /dev/video0 through V4L2 APIs. Otherwise,
          native APIs are used through /dev/config0, /dev/frame0,
          and /dev/control0.

comment "Camera Sensor Selection"
config MT9T013
	bool "Sensor mt9t013 (BAYER 3M)"
	depends on MSM_CAMERA && !ARCH_MSM8X60 && !ARCH_MSM8960 && !MSM_CAMERA_V4L2
	default y
	---help---
	  MICRON 3M Bayer Sensor with AutoFocus
config MT9D113
	bool "Sensor mt9d113 (YUV 2M)"
	depends on MSM_CAMERA && ARCH_MSM8X60 && !MSM_CAMERA_V4L2
	default y
	---help---
	  MICRON 2M YUV Sensor
	  This sensor is the front camera on QT8660.
	  This uses csi mipi interface.
	  This sensor is used only on QT device.
config MT9D112
	bool "Sensor mt9d112 (YUV 2M)"
	depends on MSM_CAMERA && !ARCH_MSM8X60 && !ARCH_MSM8960 && !MSM_CAMERA_V4L2
	default y
	---help---
	  MICRON 2M YUV Sensor
config IMX074
	bool "Sensor IMX074 (BAYER 13.5M)"
	depends on MSM_CAMERA
	---help---
	SONY 13.5 MP Bayer Sensor

# LGE_CHANGE_S : 2012-09-14 sungmin.cho@lge.com camera bring up
config T8EV4
	bool "Sensor T8EV4 (BAYER 8M)"
	depends on MSM_CAMERA && MSM_CAMERA_V4L2
	---help---
	Toshiba 8 MP Bayer Sensor

config T8EV4_ACT
	bool "Actuator t8ev4 (BAYER 8M)"
	depends on MSM_CAMERA && MSM_CAMERA_V4L2
	select MSM_ACTUATOR
	---help---
	Actuator for Toshiba 8MP Bayer Sensor	
	
config HI707
	bool "Sensor HI707 (SOC VGA)"
	depends on MSM_CAMERA && MSM_CAMERA_V4L2
	---help---
	Hynix VGA Soc Sensor

config IMX111
	bool "Sensor IMX111 (Sony 8MP)"
	depends on MSM_CAMERA && MSM_CAMERA_V4L2
	---help---
	  Sony 8M Bayer Sensor modules with Autofocus

config IMX111_ACT
	bool "Actuator imx111 (BAYER 8M)"
	depends on MSM_CAMERA && MSM_CAMERA_V4L2
	select MSM_ACTUATOR
	---help---
	Actuator for SONY 8 MP Bayer Sensor

# LGE_CHANGE_E : 2012-09-14 sungmin.cho@lge.com camera bring up

# LGE_CHANGE_S : 2012-10-13 sungmin.cho@lge.com hi707 is ratated 180 degree on V7 EVB2
config HI707_ROT_180
	bool "Hynix VGA ROTATE 180"
	---help---
	Hynix VGA Soc Sensor, Mount angle is rotated on V7 EVB2
# LGE_CHANGE_E : 2012-10-13 sungmin.cho@lge.com hi707 is ratated 180 degree on V7 EVB2

# LGE_CHANGE_S : 2012-11-14 sungmin.cho@lge.com DVDD and IOVDD is separated before Rev A
config HI707_PWR_SEPARATE
	bool "Hynix VGA POWER SEPARATED"
	---help---
	Hynix VGA Soc Sensor, DVDD and IOVDD is separated
# LGE_CHANGE_E : 2012-11-14 sungmin.cho@lge.com DVDD and IOVDD is separated before Rev A

# LGE_CHANGE_S: V1 T4K28 Camera Bringup - aidan.choi@lge.com 2013/03/08
config T4K28
	bool "Sensor T4K28 (YUV 2M)"
	depends on MSM_CAMERA && MSM_CAMERA_V4L2
	---help---
	Toshiba 2M YUV Sensor
# LGE_CHANGE_E: V1 T4K28 Camera Bringup - aidan.cho@lge.com 2013/03/08	

# LGE_CHANGE_S: V3 HI351 Camera Bringup - hong.junki@lge.com 2012/09/25
config HI351
	bool "Sensor HI351 (YUV 3M)"
	depends on MSM_CAMERA && MSM_CAMERA_V4L2
	---help---
	Hynix 3M YUV Sensor
# LGE_CHANGE_E: V3 HI351 Camera Bringup - hong.junki@lge.com 2012/09/25	
# LGE_CHANGE_S: 2012/11/2 mjoh@lge.com U0 Camera Bring Up
config HI542
	bool "Sensor HI542 (BAYER 5M)"
	depends on MSM_CAMERA && MSM_CAMERA_V4L2
	default n
	---help---
	Hynix 5MP Bayer Sensor
config HI542_ACT
	bool "Actuator HI542 (BAYER 5M)"
	depends on MSM_CAMERA && MSM_CAMERA_V4L2
	select MSM_ACTUATOR
	---help---
	Actuator for Hynix 5MP Bayer Sensor	
config MT9V113
	bool "Sensor MT9V113 (SOC VGA)"
	depends on MSM_CAMERA && MSM_CAMERA_V4L2
	---help---
	Aptina VGA Soc Sensor
# LGE_CHANGE_E: 2012/11/2 mjoh@lge.com U0 Camera Bring Up
config OV5640
	bool "Sensor OV5640 (YUV 5M)"
	depends on MSM_CAMERA && !MSM_CAMERA_V4L2
	default n
	---help---
	Omni 5M YUV Sensor

config OV5647
	bool "Sensor ov5647 (BAYER 5M)"
	depends on MSM_CAMERA
	---help---
	  OV 5M Bayer Sensor with AutoFocus

config AD5046_ACT
	bool "Lens actuator ad5046"
	depends on MSM_CAMERA && OV5647
	---help---
	  ad5046 lens actuator driver for ov5647.
	  Say Y here if this is msm7627A variant platform.
config WEBCAM_OV7692_QRD
	bool "Sensor OV7692 QRD(VGA YUV)"
	depends on MSM_CAMERA && (ARCH_MSM7X27A || ARCH_MSM8X60)
	default n
	---help---
	  Omni Vision VGA YUV Sensor for QRD Devices
config MT9M114
        bool "Sensor MT9M114 (YUV 1.26M)"
        depends on MSM_CAMERA
        ---help---
        APTINA 1.26 MP yuv Sensor
config WEBCAM_OV7692
	bool "Sensor OV7692 (VGA YUV)"
	depends on MSM_CAMERA && ARCH_MSM8X60 && !MSM_CAMERA_V4L2
	default y
	---help---
	  Omni Vision VGA YUV Sensor.
config WEBCAM_OV9726
	bool "Sensor OV9726 (VGA Bayer)"
	depends on MSM_CAMERA && (ARCH_MSM8X60 || ARCH_MSM7X30 || ARCH_MSM7X27A)
	default n
	---help---
	  Omni Vision VGA Bayer Sensor.
#	This Senosr is used as a webcam.
#	This uses the CSI interface.
config VX6953
	bool "Sensor VX6953 (BAYER 5M)"
	depends on MSM_CAMERA && (ARCH_MSM7X30 || ARCH_MSM8X60) && !MSM_CAMERA_V4L2
	default y
	---help---
	STM 5M Bayer Sensor with EDOF
config SN12M0PZ
	bool "Sensor sn12m0pz (Bayer 12 MP)"
	depends on MSM_CAMERA && ARCH_MSM7X30 && !MSM_CAMERA_V4L2
	default y
	---help---
	  Sony 12 MP Bayer Sensor
config MT9P012
	bool "Sensor mt9p012 (BAYER 5M)"
	depends on MSM_CAMERA && !ARCH_MSM8X60 && !MSM_CAMERA_V4L2
	default y
	---help---
	  MICRON 5M Bayer Sensor with Autofocus

choice
	prompt "AF module"
	depends on MT9P012 && !ARCH_MSM8X60 && !MSM_CAMERA_V4L2
	default MSM_CAMERA_AF_FOXCONN

config MSM_CAMERA_AF_FOXCONN
	bool "FOXCONN Module"
	help
	  This driver supports FOXCONN AF module for 5M Bayer sensor

config MSM_CAMERA_AF_BAM
	bool "BAM Module"
	help
	  This driver supports BAM AF module for 5M Bayer sensor

endchoice

config MT9P012_KM
	bool "Sensor mt9p012 KM module (BAYER 5M)"
	depends on MSM_CAMERA && !ARCH_MSM8X60 && !MSM_CAMERA_V4L2
	default y
	---help---
	  MICRON 5M Bayer Sensor KM modules with Autofocus

config MT9E013
	bool "Sensor mt9e013 module (BAYER 8M)"
	depends on MSM_CAMERA && (ARCH_MSM7X30 || ARCH_MSM8X60 || ARCH_MSM7X27A)
	default n
	---help---
	  Aptina 8M Bayer Sensor modules with Autofocus

config MT9E013_LGIT
	bool "Sensor MT9E013 LGIT module (BAYER 8M)"
	depends on MSM_CAMERA && MSM_CAMERA_V4L2
	default n
	---help---   
	APTINA 8M Bayer Sensor with Autofocus 
config MT9E013_LGIT_ACT
	bool "Actuator MT9E013 LGIT module (BAYER 8M)"
	depends on MSM_CAMERA && MSM_CAMERA_V4L2
	select MSM_ACTUATOR
	---help---
	Actuator for APTINA 8M Bayer Sensor
	
config IMX074_ACT
	bool "Actuator IMX074 (BAYER 13.5M)"
	depends on MSM_CAMERA
	---help---
	Actuator for SONY 13.5 MP Bayer Sensor

config S5K3E2FX
	bool "Sensor s5k3e2fx (Samsung 5M)"
	depends on MSM_CAMERA && !ARCH_MSM8X60 && !MSM_CAMERA_V4L2
	default y
	---help---
	  Samsung 5M with Autofocus

config QS_S5K4E1
	bool "Sensor qs_s5k4e1 (Samsung 5M)"
	depends on MSM_CAMERA && ARCH_MSM8X60 && !MSM_CAMERA_V4L2
	default y
	---help---
	  Samsung 5M with Autofocus

config S5K4E1
	bool "Sensor Sensor s5k4e1 (Samsung 5M)"
	depends on MSM_CAMERA
	default n
	---help---
	  Support for S5k4E1 samsung sensor driver.
	  It is a Bayer 5MP sensor with auto focus and it supports
	  two mipi lanes, required for msm7x2xA platform.
	  Say Y here if this is msm7x2xA variant platform.

config DW9712_ACT
	bool "Lens actuator dw9721"
	depends on MSM_CAMERA && S5K4E1
	---help---
	  dw9721 lens actuator driver for S5K4E1.
	  Say Y here if this is msm7627A variant platform.

config MSM_CAMERA_FLASH_SC628A
	bool "Qualcomm MSM camera sc628a flash support"
	depends on MSM_CAMERA
	default n
	---help---
	  Enable support for LED flash for msm camera.
	  It is a samtech charge pump flash driver and it
	  supports spotlight and flash light modes with
	  differrent current levels.

config MSM_CAMERA_FLASH_TPS61310
	bool "Qualcomm MSM camera tps61310 flash support"
	depends on MSM_CAMERA
	default n
	---help---
	  Enable support for LED flash for msm camera.
	  It is a Texas Instruments multiple LED Flash
	  for camera flash and video light applications.

config IMX072
	bool "Sensor imx072 (Sony 5M)"
	default n
	---help---
	  Support for IMX072 sony sensor driver.
	  It is a Bayer 5MP sensor with auto focus and it supports
	  two mipi lanes, required for msm7x2xA platform.
	  Say Y here if this is msm7x2xA variant platform.

config OV2720
	bool "Sensor ov2720 (Omnivision 2MP)"
	depends on MSM_CAMERA

config OV8825
	bool "Sensor ov8825 (Omnivision 8M)"
	depends on MSM_CAMERA
	---help---
	  Support for OV8825 sensor driver.
	  It is a Bayer 8MP sensor with auto focus and it supports
	  two mipi lanes, required for msm8625 platform.
	  Say Y here if this is msm8625 variant platform.

config VB6801
	bool "Sensor vb6801"
	depends on MSM_CAMERA && !ARCH_MSM8X60 && !MSM_CAMERA_V4L2
	---help---
	  5M with flash

config MSM_CAMERA_FLASH
	bool "Qualcomm MSM camera flash support"
	depends on MSM_CAMERA
	default y
	---help---
	  Enable support for LED flash for msm camera

config MSM_CAMERA_SENSOR
	bool "Qualcomm MSM camera sensor support"
	depends on MSM_CAMERA

config MSM_ACTUATOR
	bool "Qualcomm MSM actuator support"
	depends on MSM_CAMERA

config MSM_EEPROM
	bool "Qualcomm MSM EEPROM support"
	depends on MSM_CAMERA

config IMX074_EEPROM
	bool "IMX074 EEPROM support"
	depends on MSM_CAMERA

config IMX091_EEPROM
	bool "IMX091 EEPROM support"
	depends on MSM_CAMERA

config MSM_GEMINI
	tristate "Qualcomm MSM Gemini Jpeg Engine support"
	depends on MSM_CAMERA && (ARCH_MSM7X30 || ARCH_MSM8X60 || ARCH_MSM8960)
	default n
	---help---
	  Enable support for Gemini Jpeg Engine

config MSM_VPE
	tristate "Qualcomm MSM Video Pre-processing Engine support"
	depends on MSM_CAMERA && (ARCH_MSM7X30 || ARCH_MSM8X60)
	default y
	---help---
	  Enable support for Video Pre-processing Engine

config QUP_EXCLUSIVE_TO_CAMERA
	bool "QUP exclusive to camera"
	depends on MSM_CAMERA
	default y
	---help---
	  This flag enabled states that QUP
	  is exclusive to camera. In case this
	  is disabled, the lvs1 voltage is enabled
	  by QUP in the board file as QUP is used by
	  applications other than camera.

config S5K3L1YX
	bool "Sensor S5K3L1YX (BAYER 12M)"
	depends on MSM_CAMERA
	---help---
		Samsung 12 MP Bayer Sensor with auto focus, uses
		4 mipi lanes, preview config = 1984 * 1508 at 30 fps,
		snapshot config = 4000 * 3000 at 20 fps,
		hfr video at 60, 90 and 120 fps.

config IMX091
        bool "Sensor imx091 (Sony 13MP)"
        depends on MSM_CAMERA
	---help---
	  Sony 13MP sensor back camera that uses 4 mipi lanes,
	  runs at 30 fps preview and 14 fps snapshot

config MSM_V4L2_VIDEO_OVERLAY_DEVICE
	tristate "Qualcomm MSM V4l2 video overlay device"
	---help---
	  Enables support for the MSM V4L2 video
	  overlay driver. This allows video rendering
	  apps to render overlaid video using Video4Linux2
	  APIs, by using /dev/videoX device

config OV7692
	bool "Sensor OV7692 (VGA YUV)"
	depends on MSM_CAMERA
	---help---
	  Omni Vision VGA YUV Sensor
```
