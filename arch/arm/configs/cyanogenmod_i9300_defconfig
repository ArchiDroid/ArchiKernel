## arch/arm/mach-msm/lge/Kconfig
```kconfig
config MACH_LGE
	bool
	
menu "LGE Board Selection"
source "arch/arm/mach-msm/lge/Kconfig.board"
endmenu

config LGE_SILENCE_RESET
       tristate "Support LGE Kernel Silence Reset"
       default n
       depends on MACH_LGE
       depends on ANDROID_RAM_CONSOLE
       help
        LGE crash handler

config LGE_HANDLE_PANIC
	tristate "Support LGE Kernel Panic Handler"
	default n 
	depends on MACH_LGE
	depends on ANDROID_RAM_CONSOLE
	help
	 LGE crash handler

config LGE_LAST_SYSFS_FILE_INFO
        depends on MACH_LGE
        default n
        bool "Last Sysfs info"
        help
	 Provides last sysfs file accessed info

config LGE_REPORT_RMT_STORAGE_CLIENT_READY
       bool "Report that RMT_STORAGE_CLIENT is ready to modem"
       depends on MACH_LGE
       default n
       help
	 Report that Remote storage client is ready to modem.
	 After this signal modem can call efs_sync().

config LGE_PROC_COMM
	bool "LGE added proc comm"
	default y
	help
	 LGE added proc_comm

config LGE_BOOT_MODE
	bool "LGE boot mode"
	depends on MACH_LGE
	default n
	help
	 This feature shows boot mode to userspace through sysfs

config LGE_BLOCKING_MONITOR
	bool "LGE Blocking Monitor"
	depends on MACH_LGE
	default n
	help
	 This feature shows call stack when the function call is blocked
	 for predefined time

config LGE_HW_REVISION
	bool "LGE PCB Revision"
	default y
	help
	 Detects LGE Board PCB Revision

config LGE_PM_BATT_ID_DETECTION
       bool "Detects Battery Id from modem"
       default n
       help
	 Detects Battery ID from modem(See lge_pm.h for battery id types)

config LGE_LCD_ESD_DETECTION
	bool "Enable to reset LCD on ESD detection"
	depends on MACH_LGE
	default n
	help
	 This enables ESD detection of LCD & resets LCD if ESD shock occurs.

config LGE_UART_MODE
	bool "Support LGE UART ENABLE DISABLE"
	default n
	depends on SERIAL_MSM_CONSOLE
	help
	 UART ENABLE DISABLE HANDLING

config LGE_BOARD_HEADER_FILE
	string "LGE board specific header file name"
	depends on MACH_LGE
	default ""
	help
	 Specifies the board header file for particular model
	 (Eg: board_v7.h).This config must be set

config LGE_BDI_TIMER_BUG_PATCH
	bool "LGE bdi timer bug patch"
	default n 
	depends on MACH_LGE
	help
	  This patch is added for preventing from kernel panic which is
	  generated during executing bdi_writeback_thread(). Root cause of
	  this kernel panic starts from the synchronization problem between
	  kernel threads. When mmc card is once removed, kernel try to 
	  unregister data structures of bdi and delete bdi timer in kthread
	  context. But, if bdi writeback kthread is already in execution,
	  there is a probablity that that kthread trys to delete bdi timer
	  which has been deleted already. In that case, 
	  "del_timer(&wb->wakeup_timer)" code can generate kernel panic.
	  So, I add the codes which checks whether bdi is unregitered or not 
	  before removing timer.                

config LGE_WAIT_FOR_EFS_SYNC_COMPLETE
	bool "Wait in power off/reset until SYNC complete"
	depends on MACH_LGE
	default n
	help
	 This patch waits in power down/ reset handler if any efs sync is going on.
	 Turn Off phone only when currently active sync complete.This makes sure that
	 modem file system is proper.

config MACH_LGE_NO_DEBUG_INFO
	depends on MACH_LGE
	default n
	bool "MSM7x27A U0 DEBUG Option"
	help
	 Support for the LG Electronics MSM7x27A U0.

config MACH_LGE_NO_STOCK_INFO
	depends on MACH_LGE
	default y
	bool "LG Stock DEBUG INFO"
	help
	 LG Stock DEBUG INFO

config MACH_LGE_2ND_GEN_KK_WORKAROUD
	depends on MACH_LGE
	bool "MSM7x25A V3 errors Workaround"
	default n
	help
	 Disable support for "Copy splash image to kernel memory" and KeyLED.
	 The 2nd gen devices not have this support in bootloader.
	 And KeyLED make screen On forever.
```

## arch/arm/mach-msm/lge/Kconfig.board
```kconfig
#
# Inlcude the specific Kconfig file for LGE board
#

# LGE V3 Model
source "arch/arm/mach-msm/lge/vee3/Kconfig"

# LGE V7 Model
source "arch/arm/mach-msm/lge/vee7/Kconfig"

# LGE U0 Model
source "arch/arm/mach-msm/lge/u0/Kconfig"

# LGE M4 Model
source "arch/arm/mach-msm/lge/m4/Kconfig"

# LGE V1 Model
source "arch/arm/mach-msm/lge/v1/Kconfig"
```

## arch/arm/mach-msm/lge/m4/Kconfig
```kconfig
config MACH_MSM7X25A_M4
    depends on ARCH_MSM7X27A
    depends on !MSM_STACKED_MEMORY
    select MACH_LGE
    bool "MSM7x25A M4"
    help
        Support for the LG Electronics MSM7x25AB M4.
```

## arch/arm/mach-msm/lge/u0/Kconfig
```kconfig
config MACH_MSM7X27A_U0
    depends on ARCH_MSM7X27A
    depends on !MSM_STACKED_MEMORY
    select MACH_LGE
    bool "MSM7x27A U0"
    help
        Support for the LG Electronics MSM7x27A U0.
```

## arch/arm/mach-msm/lge/v1/Kconfig
```kconfig
config MACH_MSM7X25A_V1
    depends on ARCH_MSM7X27A
    depends on !MSM_STACKED_MEMORY
    select MACH_LGE
    bool "MSM7x25A V1"
    help
        Support for the LG Electronics MSM7x25AB V1.
```

## arch/arm/mach-msm/lge/vee3/Kconfig
```kconfig
config MACH_MSM7X25A_V3
    depends on ARCH_MSM7X27A
    depends on !MSM_STACKED_MEMORY
    select MACH_LGE
    bool "MSM7x25A V3"
    help
        Support for the LG Electronics MSM7x25A V3.

config MACH_MSM7X25A_V3_DS
    depends on ARCH_MSM7X27A
    depends on !MSM_STACKED_MEMORY
    depends on MACH_MSM7X25A_V3
    select MACH_LGE
    bool "MSM7x25A V3 DS"
    help
        Support for the LG Electronics MSM7x25A V3 DualSim.
```

## arch/arm/mach-msm/lge/vee7/Kconfig
```kconfig
config MACH_MSM8X25_V7
	depends on ARCH_MSM8625
	depends on !MSM_STACKED_MEMORY
	select MACH_LGE
	bool "MACH_MSM8X25_V7"
	help
	  Support for the LG Electronics vee7 board LGE.

config MACH_MSM8X25_U0
	depends on ARCH_MSM8625
	select MACH_LGE
	bool "MSM8X25_U0"
	help
	  Support for the LG Electronics MSM8X25 U0 swap version.(E2 release )

config MACH_MSM8X25_HDK
	depends on ARCH_MSM8625
	select MACH_LGE
	bool "MSM8X25_HDK"
	help
	  Support for the LG Electronics MSM8X25 HDK.
```
