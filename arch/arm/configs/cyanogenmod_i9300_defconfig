## drivers/mmc/core/Kconfig
```kconfig
#
# MMC core configuration
#

config MMC_UNSAFE_RESUME
	bool "Assume MMC/SD cards are non-removable (DANGEROUS)"
	help
	  If you say Y here, the MMC layer will assume that all cards
	  stayed in their respective slots during the suspend. The
	  normal behaviour is to remove them at suspend and
	  redetecting them at resume. Breaking this assumption will
	  in most cases result in data corruption.

	  This option is usually just for embedded systems which use
	  a MMC/SD card for rootfs. Most people should say N here.

	  This option sets a default which can be overridden by the
	  module parameter "removable=0" or "removable=1".

config MMC_CLKGATE
	bool "MMC host clock gating (EXPERIMENTAL)"
	depends on EXPERIMENTAL
	help
	  This will attempt to aggressively gate the clock to the MMC card.
	  This is done to save power due to gating off the logic and bus
	  noise when the MMC card is not in use. Your host driver has to
	  support handling this in order for it to be of any use.

	  If unsure, say N.

config MMC_EMBEDDED_SDIO
	boolean "MMC embedded SDIO device support (EXPERIMENTAL)"
	depends on EXPERIMENTAL
	help
	  If you say Y here, support will be added for embedded SDIO
	  devices which do not contain the necessary enumeration
	  support in hardware to be properly detected.

config MMC_PARANOID_SD_INIT
	bool "Enable paranoid SD card initialization (EXPERIMENTAL)"
	depends on EXPERIMENTAL
	help
	  If you say Y here, the MMC layer will be extra paranoid
	  about re-trying SD init requests. This can be a useful
	  work-around for buggy controllers and hardware. Enable
	  if you are experiencing issues with SD detection.

# LGE_CHANGE_S : bohyun.jung@lge.com 
config MMC_ISSUE_HPI_CMD_ON_PRG_STATE
	bool "Enable HPI CMD on PRG_STATE"
	default y
	help
	  If you say Y here, the MMC only issue HPI command on PRG state.
	  remove possibility of infinite loop; continously sending HPI command
	  not recommanded on emmc spec.

config MACH_SAMSUNG_EMMC_V441_PLUS
	bool "Samsung EMMC ver. 4.41 Plus"
	default n
	help
	  If you say Y here, disable bkops.

config MACH_FEATURE_DISCARD
	bool "Discard Option"
	default n
	help
	  If you say Y here, additional feature like discard is enabled.
	  Before actually enable discard, it double check emmc version and manufacture id.
	  support over 4.5 or samsung emmc 4.41+ (vendor confirm).

# LGE_CHANGE_E : bohyun.jung@lge.com 
```

## drivers/nfc/Kconfig
```kconfig
#
# Near Field Communication (NFC) devices
#

menuconfig NFC_DEVICES
	bool "Near Field Communication (NFC) devices"
	default n
	---help---
	  You'll have to say Y if your computer contains an NFC device that
	  you want to use under Linux.

	  You can say N here if you don't have any Near Field Communication
	  devices connected to your computer.

if NFC_DEVICES

#LGE_CHANGE_S : seven.kim@lge.com kernel3.0 porting
config LGE_NFC_NXP_PN544PN65N
	bool "PN544 NFC driver"
	#depends on I2C
	#select CRC_CCITT
	default y
	---help---
	  Say yes if you want PN544 Near Field Communication driver.
	  This is for i2c connected version. If unsure, say N here.

	  To compile this driver as a module, choose m here. The module will
	  be called pn544.
#LGE_CHANGE_E : seven.kim@lge.com kernel3.0 porting 

config PN544_NFC
	tristate "PN544 NFC driver"
	depends on I2C
	select CRC_CCITT
	default n
	---help---
	  Say yes if you want PN544 Near Field Communication driver.
	  This is for i2c connected version. If unsure, say N here.

	  To compile this driver as a module, choose m here. The module will
	  be called pn544.

config LGE_NFC_PRESTANBY
	bool "NFC STANBY MODE"
	default n
	---help---
	  Say yes if you want to change a power state of pn544 to stanby mode in Kernel.
	  If unsure, say N here.

endif # NFC_DEVICES
```

## drivers/staging/lz4/Kconfig
```kconfig
config LZ4_COMPRESS
	tristate "LZ4 Compression"
	default n

config LZ4_DECOMPRESS
	tristate "LZ4 Decompression"
	default n
```

## drivers/staging/prima_legacy/Kconfig
```kconfig
comment "Qualcomm Atheros Prima WLAN module Legacy"
config PRIMA_WLAN_LEGACY
	tristate "Qualcomm Atheros Prima WLAN module"
	default n
	help
	Add support for the Qualcomm Atheros Prima WLAN module

#	depends on WLAN
#	depends on CFG80211
#        depends on WCNSS_CORE

if PRIMA_WLAN_LEGACY != n

config PRIMA_WLAN_BTAMP_LEGACY
	bool "Enable the Prima WLAN BT-AMP feature"
	default n

endif # PRIMA_WLAN
```

## drivers/switch/Kconfig
```kconfig
menuconfig SWITCH
	tristate "Switch class support"
	help
	  Say Y here to enable switch class support. This allows
	  monitoring switches by userspace via sysfs and uevent.

if SWITCH

config SWITCH_GPIO
	tristate "GPIO Swith support"
	depends on GENERIC_GPIO
	help
	  Say Y here to enable GPIO based switch support.

# LGE_UPDATE_S	: jaz.john@lge.com  20120421
# headset detect switch
config LGE_SWITCH_GPIO
	bool "LGE GPIO Swith support"
	depends on GENERIC_GPIO
	help
	  Say Y here to enable LGE GPIO based switch support.
# LGE_UPDATE_E		20120421	

config LGE_HEADSET_DETECTION_FSA8008
    tristate "FSA8008 Headset Switch"
	help
	  Say Y here to enable LGE headset detector ic.


endif # SWITCH
```

## lge/Kconfig
```kconfig
#platform.team@lge.com	2011.01

menu "LGE Factory Feature"
source "lge/factory/Kconfig"
endmenu
```

## lge/factory/Kconfig
```kconfig
#platform.team@lge.com	2011.01

config LGE_FACTORY
	depends on !MACH_MSM7X27A_U0
        default y
        bool "LGE factory Configuration"
        help
                LGE factory Configuration

config LGE_SUPPORT_RAPI
        default y
        bool "LGE Remote communcation api support"
        help
                LGE Remote communcation api support

config LGE_DIAGTEST
        depends on LGE_FACTORY
        default y
        bool "LGE TestMode Diag Support"
        help
                LGE TestMode Diag Supports

config LGE_DIAG_KEYPRESS
        depends on LGE_DIAGTEST
        default n
        bool "LGE UTS KEYPRESS Support"
        help
                LGE UTS KEYPRESS Supports

config LGE_DLOAD_SRD
        depends on LGE_FACTORY
        default y
        bool "LGE Dload SelfRecoveryDownload Support"
        help
                LGE Dload SelfRecoveryDownload Support

config LGE_EMMC_DIRECT_ACCESS
	default y
	bool "LGE eMMC direct access driver"
	help
                LGE eMMC direct access driver
```
